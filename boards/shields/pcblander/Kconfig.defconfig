## boards/shields/pcblander/Kconfig.defconfig
```kconfig
if SHIELD_PCBLANDER_LEFT

config ZMK_KEYBOARD_NAME
    default "PCBLander"

config ZMK_SPLIT_ROLE_CENTRAL
    default y

endif

if SHIELD_PCBLANDER_LEFT || SHIELD_PCBLANDER_RIGHT

config ZMK_SPLIT
    default y

endif
```

## boards/shields/pcblander/Kconfig.shield
```kconfig
config SHIELD_PCBLANDER_LEFT
    def_bool $(shields_list_contains,pcblander_left)

config SHIELD_PCBLANDER_RIGHT
    def_bool $(shields_list_contains,pcblander_right)
```
